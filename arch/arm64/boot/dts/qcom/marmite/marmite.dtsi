/* Copyright (c) 2020, The Linux Foundation. All rights reserved.
*  Copyright (c) 2020, Jebaitedneko.
*
* This program is free software; you can redistribute it and/or modify
* it under the terms of the GNU General Public License version 2 and
* only version 2 as published by the Free Software Foundation.
*
* This program is distributed in the hope that it will be useful,
* but WITHOUT ANY WARRANTY; without even the implied warranty of
* MERCHANTABILITY or FITNESS FOR A PARTICULAR PURPOSE.  See the
* GNU General Public License for more details.
*/

#include "marmite-audio.dtsi"
#include "marmite-camera.dtsi"
#include "marmite-general.dtsi"
#include "marmite-mdss.dtsi"
#include "marmite-misc.dtsi"
#include "marmite-pinctrl.dtsi"
#include "marmite-power.dtsi"
