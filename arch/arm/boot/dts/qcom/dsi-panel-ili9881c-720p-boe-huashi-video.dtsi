/* Copyright (c) 2014, The Linux Foundation. All rights reserved.
 *
 * This program is free software; you can redistribute it and/or modify
 * it under the terms of the GNU General Public License version 2 and
 * only version 2 as published by the Free Software Foundation.
 *
 * This program is distributed in the hope that it will be useful,
 * but WITHOUT ANY WARRANTY; without even the implied warranty of
 * MERCHANTABILITY or FITNESS FOR A PARTICULAR PURPOSE.  See the
 * GNU General Public License for more details.
 */

&mdss_mdp {
	dsi_ili9881c_720p_boe_huashi_video: qcom,mdss_dsi_ili9881c_720p_boe_huashi_video {
		qcom,mdss-dsi-panel-name = "ili9881c 720p boe huashi video mode dsi panel";
		qcom,mdss-dsi-panel-type = "dsi_video_mode";
		qcom,mdss-dsi-panel-framerate = <60>;
		qcom,mdss-dsi-virtual-channel-id = <0>;
		qcom,mdss-dsi-stream = <0>;
		qcom,mdss-dsi-panel-width = <720>;
		qcom,mdss-dsi-panel-height = <1280>;
		qcom,mdss-dsi-h-front-porch = <80>;
		qcom,mdss-dsi-h-back-porch = <100>;
		qcom,mdss-dsi-h-pulse-width = <10>;
		qcom,mdss-dsi-h-sync-skew = <0>;
		qcom,mdss-dsi-v-back-porch = <18>;
		qcom,mdss-dsi-v-front-porch = <20>;
		qcom,mdss-dsi-v-pulse-width = <8>;
		qcom,mdss-dsi-h-left-border = <0>;
		qcom,mdss-dsi-h-right-border = <0>;
		qcom,mdss-dsi-v-top-border = <0>;
		qcom,mdss-dsi-v-bottom-border = <0>;
		qcom,mdss-dsi-bpp = <24>;
		qcom,mdss-dsi-underflow-color = <0xff>;
		qcom,mdss-dsi-border-color = <0>;
		qcom,mdss-dsi-h-sync-pulse = <0>;
		qcom,mdss-dsi-on-command = [
				29 01 00 00 00 00 04 FF 98 81 03
				29 01 00 00 00 00 02 01 00
				29 01 00 00 00 00 02 02 00
				29 01 00 00 00 00 02 03 73
				29 01 00 00 00 00 02 04 00
				29 01 00 00 00 00 02 05 00
				29 01 00 00 00 00 02 06 0C
				29 01 00 00 00 00 02 07 00
				29 01 00 00 00 00 02 08 00
				29 01 00 00 00 00 02 09 01
				29 01 00 00 00 00 02 0a 01
				29 01 00 00 00 00 02 0b 01
				29 01 00 00 00 00 02 0c 01
				29 01 00 00 00 00 02 0d 01
				29 01 00 00 00 00 02 0e 01
				29 01 00 00 00 00 02 0f 00
				29 01 00 00 00 00 02 10 00 
				29 01 00 00 00 00 02 11 00
				29 01 00 00 00 00 02 12 00
				29 01 00 00 00 00 02 13 00
				29 01 00 00 00 00 02 14 00
				29 01 00 00 00 00 02 15 00
				29 01 00 00 00 00 02 16 00 
				29 01 00 00 00 00 02 17 00 
				29 01 00 00 00 00 02 18 00
				29 01 00 00 00 00 02 19 00
				29 01 00 00 00 00 02 1a 00
				29 01 00 00 00 00 02 1b 00
				29 01 00 00 00 00 02 1c 00
				29 01 00 00 00 00 02 1d 00
				29 01 00 00 00 00 02 1e 44
				29 01 00 00 00 00 02 1f C0
				29 01 00 00 00 00 02 20 0A
				29 01 00 00 00 00 02 21 03
				29 01 00 00 00 00 02 22 0A
				29 01 00 00 00 00 02 23 00
				29 01 00 00 00 00 02 24 8C
				29 01 00 00 00 00 02 25 8C
				29 01 00 00 00 00 02 26 00
				29 01 00 00 00 00 02 27 00
				29 01 00 00 00 00 02 28 3B
				29 01 00 00 00 00 02 29 03
				29 01 00 00 00 00 02 2a 00
				29 01 00 00 00 00 02 2b 00
				29 01 00 00 00 00 02 2c 00
				29 01 00 00 00 00 02 2d 00
				29 01 00 00 00 00 02 2e 00
				29 01 00 00 00 00 02 2f 00
				29 01 00 00 00 00 02 30 00
				29 01 00 00 00 00 02 31 00
				29 01 00 00 00 00 02 32 00
				29 01 00 00 00 00 02 33 00
				29 01 00 00 00 00 02 34 00
				29 01 00 00 00 00 02 35 00
				29 01 00 00 00 00 02 36 00
				29 01 00 00 00 00 02 37 00
				29 01 00 00 00 00 02 38 00
				29 01 00 00 00 00 02 39 00
				29 01 00 00 00 00 02 3a 00 
				29 01 00 00 00 00 02 3b 00
				29 01 00 00 00 00 02 3c 00
				29 01 00 00 00 00 02 3d 00
				29 01 00 00 00 00 02 3e 00
				29 01 00 00 00 00 02 3f 00
				29 01 00 00 00 00 02 40 00
				29 01 00 00 00 00 02 41 00
				29 01 00 00 00 00 02 42 00
				29 01 00 00 00 00 02 43 00
				29 01 00 00 00 00 02 44 00  
				29 01 00 00 00 00 02 50 01
				29 01 00 00 00 00 02 51 23
				29 01 00 00 00 00 02 52 45
				29 01 00 00 00 00 02 53 67
				29 01 00 00 00 00 02 54 89
				29 01 00 00 00 00 02 55 AB
				29 01 00 00 00 00 02 56 01
				29 01 00 00 00 00 02 57 23
				29 01 00 00 00 00 02 58 45
				29 01 00 00 00 00 02 59 67
				29 01 00 00 00 00 02 5a 89
				29 01 00 00 00 00 02 5b AB
				29 01 00 00 00 00 02 5c CD
				29 01 00 00 00 00 02 5d EF
				29 01 00 00 00 00 02 5e 11
				29 01 00 00 00 00 02 5f 0c
				29 01 00 00 00 00 02 60 0d
				29 01 00 00 00 00 02 61 0e
				29 01 00 00 00 00 02 62 0f
				29 01 00 00 00 00 02 63 06
				29 01 00 00 00 00 02 64 07
				29 01 00 00 00 00 02 65 02
				29 01 00 00 00 00 02 66 02
				29 01 00 00 00 00 02 67 02
				29 01 00 00 00 00 02 68 02
				29 01 00 00 00 00 02 69 02
				29 01 00 00 00 00 02 6a 02
				29 01 00 00 00 00 02 6b 02
				29 01 00 00 00 00 02 6c 02
				29 01 00 00 00 00 02 6d 02
				29 01 00 00 00 00 02 6e 02
				29 01 00 00 00 00 02 6f 02
				29 01 00 00 00 00 02 70 02
				29 01 00 00 00 00 02 71 02
				29 01 00 00 00 00 02 72 02
				29 01 00 00 00 00 02 73 01
				29 01 00 00 00 00 02 74 00
				29 01 00 00 00 00 02 75 0c
				29 01 00 00 00 00 02 76 0d
				29 01 00 00 00 00 02 77 0e
				29 01 00 00 00 00 02 78 0f
				29 01 00 00 00 00 02 79 06
				29 01 00 00 00 00 02 7a 07
				29 01 00 00 00 00 02 7b 02
				29 01 00 00 00 00 02 7c 02
				29 01 00 00 00 00 02 7d 02
				29 01 00 00 00 00 02 7e 02
				29 01 00 00 00 00 02 7f 02
				29 01 00 00 00 00 02 80 02
				29 01 00 00 00 00 02 81 02
				29 01 00 00 00 00 02 82 02
				29 01 00 00 00 00 02 83 02
				29 01 00 00 00 00 02 84 02
				29 01 00 00 00 00 02 85 02
				29 01 00 00 00 00 02 86 02
				29 01 00 00 00 00 02 87 02
				29 01 00 00 00 00 02 88 02
				29 01 00 00 00 00 02 89 01
				29 01 00 00 00 00 02 8A 00
				29 01 00 00 00 00 04 FF 98 81 04
				29 01 00 00 00 00 02 6C 15 
				29 01 00 00 00 00 02 6E 1a
				29 01 00 00 00 00 02 6F A5
				29 01 00 00 00 00 02 3a 24
				29 01 00 00 00 00 02 8D 1F
				29 01 00 00 00 00 02 87 BA
				29 01 00 00 00 00 02 26 76            
				29 01 00 00 00 00 02 B2 D1
				29 01 00 00 00 00 02 35 1f
				29 01 00 00 00 00 04 FF 98 81 01
				29 01 00 00 00 00 02 22 09
				29 01 00 00 00 00 02 31 00
				29 01 00 00 00 00 02 40 33
				29 01 00 00 00 00 02 42 33
				29 01 00 00 00 00 02 50 A6
				29 01 00 00 00 00 02 51 A6
				29 01 00 00 00 00 02 53 5c
				29 01 00 00 00 00 02 55 5e
				29 01 00 00 00 00 02 60 06
				29 01 00 00 00 00 02 61 01
				29 01 00 00 00 00 02 62 19
				29 01 00 00 00 00 02 63 00
				29 01 00 00 00 00 02 A0 08
				29 01 00 00 00 00 02 A1 14
				29 01 00 00 00 00 02 A2 1D
				29 01 00 00 00 00 02 A3 11
				29 01 00 00 00 00 02 A4 12
				29 01 00 00 00 00 02 A5 23
				29 01 00 00 00 00 02 A6 17
				29 01 00 00 00 00 02 A7 1C
				29 01 00 00 00 00 02 A8 65
				29 01 00 00 00 00 02 A9 1D
				29 01 00 00 00 00 02 AA 29
				29 01 00 00 00 00 02 AB 5E
				29 01 00 00 00 00 02 AC 1B
				29 01 00 00 00 00 02 AD 19
				29 01 00 00 00 00 02 AE 4E
				29 01 00 00 00 00 02 AF 22
				29 01 00 00 00 00 02 B0 27
				29 01 00 00 00 00 02 B1 4B
				29 01 00 00 00 00 02 B2 5C
				29 01 00 00 00 00 02 B3 39
				29 01 00 00 00 00 02 C0 08
				29 01 00 00 00 00 02 C1 14
				29 01 00 00 00 00 02 C2 1E
				29 01 00 00 00 00 02 C3 10
				29 01 00 00 00 00 02 C4 11
				29 01 00 00 00 00 02 C5 23
				29 01 00 00 00 00 02 C6 17
				29 01 00 00 00 00 02 C7 1C
				29 01 00 00 00 00 02 C8 65
				29 01 00 00 00 00 02 C9 1D
				29 01 00 00 00 00 02 CA 29
				29 01 00 00 00 00 02 CB 56
				29 01 00 00 00 00 02 CC 1B
				29 01 00 00 00 00 02 CD 19
				29 01 00 00 00 00 02 CE 4E
				29 01 00 00 00 00 02 CF 22
				29 01 00 00 00 00 02 D0 27
				29 01 00 00 00 00 02 D1 4A
				29 01 00 00 00 00 02 D2 5C
				29 01 00 00 00 00 02 D3 39
				29 01 00 00 00 00 04 FF 98 81 00
				05 01 00 00 78 00 02 11 00
				05 01 00 00 32 00 02 29 00
				];
		qcom,mdss-dsi-off-command = [05 01 00 00 14 00 02 28 00
					05 01 00 00 78 00 02 10 00
					];
		qcom,mdss-dsi-on-command-state = "dsi_lp_mode";
		qcom,mdss-dsi-off-command-state = "dsi_lp_mode";
		qcom,mdss-dsi-panel-status-command = [06 01 00 01 05 00 02 0A 08];
		qcom,mdss-dsi-panel-status-command-state = "dsi_lp_mode";
		qcom,mdss-dsi-panel-status-check-mode = "reg_read";
		qcom,mdss-dsi-panel-status-valid-params = <1>;
		qcom,mdss-dsi-panel-status-value = <0x9c>;  
		qcom,mdss-dsi-panel-status-read-length = <1>;
		qcom,mdss-dsi-panel-orientation="180";
		qcom,esd-check-enabled;
		qcom,mdss-dsi-traffic-mode = "burst_mode";
		qcom,mdss-dsi-bllp-eof-power-mode;
		qcom,mdss-dsi-bllp-power-mode;
		qcom,mdss-dsi-lane-0-state;
		qcom,mdss-dsi-lane-1-state;
		qcom,mdss-dsi-lane-2-state;
		qcom,mdss-dsi-lane-3-state;
		qcom,mdss-dsi-panel-timings = [7A 1A 12 00 3E 42 16 5A 14 03 04 00];
		qcom,mdss-dsi-t-clk-post = <0x0a>;
		qcom,mdss-dsi-t-clk-pre = <0x2c>;
		qcom,mdss-dsi-bl-min-level = <1>;
		qcom,mdss-dsi-bl-max-level = <4095>;
		qcom,mdss-dsi-dma-trigger = "trigger_sw";
		qcom,mdss-dsi-mdp-trigger = "none";
		qcom,mdss-dsi-bl-pmic-control-type = "bl_ctrl_wled";
		qcom,mdss-dsi-reset-sequence = <1 20>, <0 2>, <1 20>;
		qcom,mdss-dsi-tx-eot-append;
	};
};
