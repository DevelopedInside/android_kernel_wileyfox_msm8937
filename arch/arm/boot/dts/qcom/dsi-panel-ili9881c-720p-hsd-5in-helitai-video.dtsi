/* Copyright (c) 2014, The Linux Foundation. All rights reserved.
 *
 * This program is free software; you can redistribute it and/or modify
 * it under the terms of the GNU General Public License version 2 and
 * only version 2 as published by the Free Software Foundation.
 *
 * This program is distributed in the hope that it will be useful,
 * but WITHOUT ANY WARRANTY; without even the implied warranty of
 * MERCHANTABILITY or FITNESS FOR A PARTICULAR PURPOSE.  See the
 * GNU General Public License for more details.
 */

&mdss_mdp {
	dsi_ili9881c_720p_hsd_5in_helitai_video: qcom,mdss_dsi_ili9881c_720p_hsd_5in_hlt_video {
		qcom,mdss-dsi-panel-name = "ili9881c 720p hsd helitai video mode dsi panel";
		qcom,mdss-dsi-panel-type = "dsi_video_mode";
		qcom,mdss-dsi-panel-framerate = <60>;
		qcom,mdss-dsi-virtual-channel-id = <0>;
		qcom,mdss-dsi-stream = <0>;
		qcom,mdss-dsi-panel-width = <720>;
		qcom,mdss-dsi-panel-height = <1280>;
		qcom,mdss-dsi-h-front-porch = <80>;
		qcom,mdss-dsi-h-back-porch = <100>;//TQY
		qcom,mdss-dsi-h-pulse-width = <10>;
		qcom,mdss-dsi-h-sync-skew = <0>;
		qcom,mdss-dsi-v-back-porch = <18>;
		qcom,mdss-dsi-v-front-porch = <20>;
		qcom,mdss-dsi-v-pulse-width = <8>;
		qcom,mdss-dsi-h-left-border = <0>;
		qcom,mdss-dsi-h-right-border = <0>;
		qcom,mdss-dsi-v-top-border = <0>;
		qcom,mdss-dsi-v-bottom-border = <0>;
		qcom,mdss-dsi-bpp = <24>;
		qcom,mdss-dsi-underflow-color = <0xff>;
		qcom,mdss-dsi-border-color = <0>;
		qcom,mdss-dsi-h-sync-pulse = <0>;
		qcom,mdss-dsi-on-command = [
				29 01 00 00 00 00 04 FF 98 81 03
				29 01 00 00 00 00 02 01 00
				29 01 00 00 00 00 02 02 00
				29 01 00 00 00 00 02 03 73
				29 01 00 00 00 00 02 04 00
				29 01 00 00 00 00 02 05 00
				29 01 00 00 00 00 02 06 0A
				29 01 00 00 00 00 02 07 00
				29 01 00 00 00 00 02 08 00
				29 01 00 00 00 00 02 09 01
				29 01 00 00 00 00 02 0A 00
				29 01 00 00 00 00 02 0B 00
				29 01 00 00 00 00 02 0C 01
				29 01 00 00 00 00 02 0D 00
				29 01 00 00 00 00 02 0E 00
				29 01 00 00 00 00 02 0F 1D
				29 01 00 00 00 00 02 10 1D
				29 01 00 00 00 00 02 11 00
				29 01 00 00 00 00 02 12 00
				29 01 00 00 00 00 02 13 00
				29 01 00 00 00 00 02 14 00
				29 01 00 00 00 00 02 15 00
				29 01 00 00 00 00 02 16 00
				29 01 00 00 00 00 02 17 00
				29 01 00 00 00 00 02 18 00
				29 01 00 00 00 00 02 19 00
				29 01 00 00 00 00 02 1A 00
				29 01 00 00 00 00 02 1B 00
				29 01 00 00 00 00 02 1C 00
				29 01 00 00 00 00 02 1D 00
				29 01 00 00 00 00 02 1E 40
				29 01 00 00 00 00 02 1F 80
				29 01 00 00 00 00 02 20 06
				29 01 00 00 00 00 02 21 02
				29 01 00 00 00 00 02 22 00
				29 01 00 00 00 00 02 23 00
				29 01 00 00 00 00 02 24 00
				29 01 00 00 00 00 02 25 00
				29 01 00 00 00 00 02 26 00
				29 01 00 00 00 00 02 27 00
				29 01 00 00 00 00 02 28 33
				29 01 00 00 00 00 02 29 03
				29 01 00 00 00 00 02 2A 00
				29 01 00 00 00 00 02 2B 00
				29 01 00 00 00 00 02 2C 00
				29 01 00 00 00 00 02 2D 00
				29 01 00 00 00 00 02 2E 00
				29 01 00 00 00 00 02 2F 00
				29 01 00 00 00 00 02 30 00
				29 01 00 00 00 00 02 31 00
				29 01 00 00 00 00 02 32 00
				29 01 00 00 00 00 02 33 00
				29 01 00 00 00 00 02 34 04
				29 01 00 00 00 00 02 35 00
				29 01 00 00 00 00 02 36 00
				29 01 00 00 00 00 02 37 00
				29 01 00 00 00 00 02 38 3C
				29 01 00 00 00 00 02 39 00
				29 01 00 00 00 00 02 3A 40
				29 01 00 00 00 00 02 3B 40
				29 01 00 00 00 00 02 3C 00
				29 01 00 00 00 00 02 3D 00
				29 01 00 00 00 00 02 3E 00
				29 01 00 00 00 00 02 3F 00
				29 01 00 00 00 00 02 40 00
				29 01 00 00 00 00 02 41 00
				29 01 00 00 00 00 02 42 00
				29 01 00 00 00 00 02 43 00
				29 01 00 00 00 00 02 44 00
				29 01 00 00 00 00 02 50 01
				29 01 00 00 00 00 02 51 23
				29 01 00 00 00 00 02 52 45
				29 01 00 00 00 00 02 53 67
				29 01 00 00 00 00 02 54 89
				29 01 00 00 00 00 02 55 ab
				29 01 00 00 00 00 02 56 01
				29 01 00 00 00 00 02 57 23
				29 01 00 00 00 00 02 58 45
				29 01 00 00 00 00 02 59 67
				29 01 00 00 00 00 02 5A 89
				29 01 00 00 00 00 02 5B ab
				29 01 00 00 00 00 02 5C cd
				29 01 00 00 00 00 02 5D ef
				29 01 00 00 00 00 02 5E 11
				29 01 00 00 00 00 02 5F 01
				29 01 00 00 00 00 02 60 00
				29 01 00 00 00 00 02 61 15
				29 01 00 00 00 00 02 62 14
				29 01 00 00 00 00 02 63 0E
				29 01 00 00 00 00 02 64 0F
				29 01 00 00 00 00 02 65 0C
				29 01 00 00 00 00 02 66 0D
				29 01 00 00 00 00 02 67 06
				29 01 00 00 00 00 02 68 02
				29 01 00 00 00 00 02 69 07
				29 01 00 00 00 00 02 6A 02
				29 01 00 00 00 00 02 6B 02
				29 01 00 00 00 00 02 6C 02
				29 01 00 00 00 00 02 6D 02
				29 01 00 00 00 00 02 6E 02
				29 01 00 00 00 00 02 6F 02
				29 01 00 00 00 00 02 70 02
				29 01 00 00 00 00 02 71 02
				29 01 00 00 00 00 02 72 02
				29 01 00 00 00 00 02 73 02
				29 01 00 00 00 00 02 74 02
				29 01 00 00 00 00 02 75 01
				29 01 00 00 00 00 02 76 00
				29 01 00 00 00 00 02 77 14
				29 01 00 00 00 00 02 78 15
				29 01 00 00 00 00 02 79 0E
				29 01 00 00 00 00 02 7A 0F
				29 01 00 00 00 00 02 7B 0C
				29 01 00 00 00 00 02 7C 0D
				29 01 00 00 00 00 02 7D 06
				29 01 00 00 00 00 02 7E 02
				29 01 00 00 00 00 02 7F 07
				29 01 00 00 00 00 02 80 02
				29 01 00 00 00 00 02 81 02
				29 01 00 00 00 00 02 82 02
				29 01 00 00 00 00 02 83 02
				29 01 00 00 00 00 02 84 02
				29 01 00 00 00 00 02 85 02
				29 01 00 00 00 00 02 86 02
				29 01 00 00 00 00 02 87 02
				29 01 00 00 00 00 02 88 02
				29 01 00 00 00 00 02 89 02
				29 01 00 00 00 00 02 8A 02
				29 01 00 00 00 00 04 FF 98 81 04
				29 01 00 00 00 00 02 6C 15
				29 01 00 00 00 00 02 6E 2A
				29 01 00 00 00 00 02 6F 35
				29 01 00 00 00 00 02 3A 94
				29 01 00 00 00 00 02 8D 15
				29 01 00 00 00 00 02 87 BA
				29 01 00 00 00 00 02 26 76
				29 01 00 00 00 00 02 B2 D1
				29 01 00 00 00 00 02 B5 06
				29 01 00 00 00 00 04 FF 98 81 01
				29 01 00 00 00 00 02 22 09
				29 01 00 00 00 00 02 31 00
				29 01 00 00 00 00 02 53 94
				29 01 00 00 00 00 02 55 8F
				29 01 00 00 00 00 02 50 9a
				29 01 00 00 00 00 02 51 9a
				29 01 00 00 00 00 02 60 22
				29 01 00 00 00 00 02 61 00
				29 01 00 00 00 00 02 62 19
				29 01 00 00 00 00 02 63 10
				29 01 00 00 00 00 02 A0 08
				29 01 00 00 00 00 02 A1 17
				29 01 00 00 00 00 02 A2 1E
				29 01 00 00 00 00 02 A3 0E
				29 01 00 00 00 00 02 A4 13
				29 01 00 00 00 00 02 A5 24
				29 01 00 00 00 00 02 A6 1B
				29 01 00 00 00 00 02 A7 1B
				29 01 00 00 00 00 02 A8 53
				29 01 00 00 00 00 02 A9 1B
				29 01 00 00 00 00 02 AA 28
				29 01 00 00 00 00 02 AB 45
				29 01 00 00 00 00 02 AC 1A
				29 01 00 00 00 00 02 AD 1A
				29 01 00 00 00 00 02 AE 50
				29 01 00 00 00 00 02 AF 25
				29 01 00 00 00 00 02 B0 2C
				29 01 00 00 00 00 02 B1 3B
				29 01 00 00 00 00 02 B2 63
				29 01 00 00 00 00 02 B3 39
				29 01 00 00 00 00 02 C0 08
				29 01 00 00 00 00 02 C1 0C
				29 01 00 00 00 00 02 C2 17
				29 01 00 00 00 00 02 C3 0F
				29 01 00 00 00 00 02 C4 0B
				29 01 00 00 00 00 02 C5 1C
				29 01 00 00 00 00 02 C6 10
				29 01 00 00 00 00 02 C7 16
				29 01 00 00 00 00 02 C8 5B
				29 01 00 00 00 00 02 C9 1A
				29 01 00 00 00 00 02 CA 26
				29 01 00 00 00 00 02 CB 55
				29 01 00 00 00 00 02 CC 1D
				29 01 00 00 00 00 02 CD 1E
				29 01 00 00 00 00 02 CE 52
				29 01 00 00 00 00 02 CF 26
				29 01 00 00 00 00 02 D0 29
				29 01 00 00 00 00 02 D1 45
				29 01 00 00 00 00 02 D2 63
				29 01 00 00 00 00 02 D3 39
				29 01 00 00 00 00 04 FF 98 81 00
				05 01 00 00 C4 00 02
					11 00
				05 01 00 00 32 00 02
					29 00
				];
		qcom,mdss-dsi-off-command = [05 01 00 00 14 00 02 28 00
					05 01 00 00 78 00 02 10 00
					];
		qcom,mdss-dsi-on-command-state = "dsi_lp_mode";
		qcom,mdss-dsi-off-command-state = "dsi_lp_mode";
		qcom,mdss-dsi-panel-status-command = [06 01 00 01 05 00 02 0A 08];
		qcom,mdss-dsi-panel-status-command-state = "dsi_lp_mode";
		qcom,mdss-dsi-panel-status-check-mode = "reg_read";
		qcom,mdss-dsi-panel-status-valid-params = <1>;
		qcom,mdss-dsi-panel-status-value = <0x9c>;  
		qcom,mdss-dsi-panel-status-read-length = <1>;
		qcom,esd-check-enabled;
		qcom,mdss-dsi-panel-orientation="180";
		qcom,mdss-dsi-traffic-mode = "burst_mode";
		qcom,mdss-dsi-bllp-eof-power-mode;
		qcom,mdss-dsi-bllp-power-mode;
		qcom,mdss-dsi-lane-0-state;
		qcom,mdss-dsi-lane-1-state;
		qcom,mdss-dsi-lane-2-state;
		qcom,mdss-dsi-lane-3-state;
		qcom,mdss-dsi-panel-timings = [7A 1A 12 00 3E 42 16 5A 14 03 04 00];
		qcom,mdss-dsi-t-clk-post = <0x20>;
		qcom,mdss-dsi-t-clk-pre = <0x2c>;
		qcom,mdss-dsi-bl-min-level = <1>;
		qcom,mdss-dsi-bl-max-level = <4095>;
		qcom,mdss-dsi-dma-trigger = "trigger_sw";
		qcom,mdss-dsi-mdp-trigger = "none";
		qcom,mdss-dsi-bl-pmic-control-type = "bl_ctrl_wled";
		qcom,mdss-dsi-reset-sequence = <1 20>, <0 2>, <1 20>;
		qcom,mdss-dsi-tx-eot-append;
	};
};
